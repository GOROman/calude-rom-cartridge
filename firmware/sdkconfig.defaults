## firmware/sdkconfig.defaults
```kconfig
CONFIG_IDF_TARGET="esp32s3"
CONFIG_ESPTOOLPY_FLASHSIZE_8MB=y
CONFIG_PARTITION_TABLE_CUSTOM=y
CONFIG_PARTITION_TABLE_CUSTOM_FILENAME="partitions.csv"
CONFIG_FREERTOS_HZ=1000
# WiFi softAP + HTTP upload
CONFIG_HTTPD_MAX_REQ_HDR_LEN=1024
CONFIG_ESP_WIFI_SOFTAP_SUPPORT=y
```
